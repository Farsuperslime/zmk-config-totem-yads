// Copyright 2022 Manna Harbour
// https://github.com/manna-harbour/miryoku

#include "miryoku/custom_config.h"
#include "miryoku/mapping/38/totem.h"
#include "miryoku/miryoku.dtsi"

// Prospector display brightness behavior.
//
// Defined unconditionally: devicetree files are preprocessed before Kconfig
// runs, so a `#ifdef CONFIG_SHIELD_PROSPECTOR_ADAPTER` here would never be
// true (CONFIG_* symbols are not visible to the DTS preprocessor). Instead the
// behavior always exists and its driver is a no-op unless the build defines
// CONFIG_SHIELD_PROSPECTOR_ADAPTER -- see src/behavior_prospector_brightness.c.
/ {
    behaviors {
        pbl: prospector_brightness {
            compatible = "zmk,behavior-prospector-brightness";
            display-name = "Prospector Brightness";
            #binding-cells = <1>;
            step = <10>;
        };
    };
};
